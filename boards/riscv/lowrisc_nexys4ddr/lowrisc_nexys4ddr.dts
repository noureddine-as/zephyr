/*
 * Copyright (c) 2018 - 2019 Antmicro <www.antmicro.com>
 *
 * SPDX-License-Identifier: Apache-2.0
 */

/dts-v1/;

#include <lowrisc-nexys4ddr.dtsi>


/ {
	model = "lowRISC SoC on Nexys4DDR";
	compatible = "lowrisc,lowrisc_nexys4ddr";

	chosen {
		zephyr,flash = &flash0;
		zephyr,sram = &sram0;
	};
};