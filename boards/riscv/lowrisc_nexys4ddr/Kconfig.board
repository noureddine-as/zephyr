## boards/riscv/lowrisc_nexys4ddr/Kconfig.board
```kconfig
# Copyright (c) 2019 BayLibre SAS
# SPDX-License-Identifier: Apache-2.0

config BOARD_LOWRISC_NEXYS4DDR
	bool "lowRISC Chip target"
	depends on SOC_RISCV_SIFIVE_FREEDOM
	select QEMU_TARGET
	select 64BIT
```

## boards/riscv/lowrisc_nexys4ddr/Kconfig.defconfig
```kconfig
# Copyright (c) 2019 BayLibre SAS
# SPDX-License-Identifier: Apache-2.0

if BOARD_LOWRISC_NEXYS4DDR

config BUILD_OUTPUT_BIN
        default n

config BOARD
	default "lowrisc_nexys4ddr"

endif
```

## boards/riscv/lowrisc_nexys4ddr/lowrisc_nexys4ddr_defconfig
```kconfig
# SPDX-License-Identifier: Apache-2.0

CONFIG_RISCV=y
CONFIG_SOC_SERIES_RISCV_LOWRISC=y
CONFIG_SOC_RISCV_LOWRISC=y
CONFIG_BOARD_LOWRISC_NEXYS4DDR=y
CONFIG_64BIT=y
CONFIG_CONSOLE=y
CONFIG_PRINTK=y
CONFIG_SERIAL=y
CONFIG_UART_LOWRISC=y
CONFIG_UART_LOWRISC_PORT_0=y
CONFIG_UART_CONSOLE=y

# In order not to choose the plic.c file
CONFIG_PLIC=n
# choose the plic_lowrisc.c file!
CONFIG_PLIC_LOWRISC=y

CONFIG_PINMUX=y
CONFIG_PINMUX_LOWRISC=y
CONFIG_RISCV_MACHINE_TIMER=y
CONFIG_GPIO=y
CONFIG_GPIO_LOWRISC=y
CONFIG_SYS_CLOCK_HW_CYCLES_PER_SEC=10000000
CONFIG_STACK_SENTINEL=y
CONFIG_TEST_EXTRA_STACKSIZE=256
```

## drivers/gpio/Kconfig.lowrisc
```kconfig
# Kconfig.fe310 - SiFive Freedom GPIO configuration option
#
# Copyright (c) 2017 Jean-Paul Etienne <fractalclone@gmail.com>
#
# SPDX-License-Identifier: Apache-2.0
#

menuconfig GPIO_LOWRISC
	bool "lowRISC GPIO driver"
	depends on SOC_RISCV_LOWRISC
	select HAS_DTS_GPIO
	help
	  Enable driver for the lowRISC controller.

	  Says n if not sure.

if GPIO_LOWRISC

config GPIO_LOWRISC_0_PRIORITY
	int "GPIO 0 interrupt priority"
	default 1

config GPIO_LOWRISC_1_PRIORITY
	int "GPIO 1 interrupt priority"
	default 1

config GPIO_LOWRISC_2_PRIORITY
	int "GPIO 2 interrupt priority"
	default 1

config GPIO_LOWRISC_3_PRIORITY
	int "GPIO 3 interrupt priority"
	default 1

config GPIO_LOWRISC_4_PRIORITY
	int "GPIO 4 interrupt priority"
	default 1

config GPIO_LOWRISC_5_PRIORITY
	int "GPIO 5 interrupt priority"
	default 1

config GPIO_LOWRISC_6_PRIORITY
	int "GPIO 6 interrupt priority"
	default 1

config GPIO_LOWRISC_7_PRIORITY
	int "GPIO 7 interrupt priority"
	default 1

config GPIO_LOWRISC_8_PRIORITY
	int "GPIO 8 interrupt priority"
	default 1

config GPIO_LOWRISC_9_PRIORITY
	int "GPIO 9 interrupt priority"
	default 1

config GPIO_LOWRISC_10_PRIORITY
	int "GPIO 10 interrupt priority"
	default 1

config GPIO_LOWRISC_11_PRIORITY
	int "GPIO 11 interrupt priority"
	default 1

config GPIO_LOWRISC_12_PRIORITY
	int "GPIO 12 interrupt priority"
	default 1

config GPIO_LOWRISC_13_PRIORITY
	int "GPIO 13 interrupt priority"
	default 1

config GPIO_LOWRISC_14_PRIORITY
	int "GPIO 14 interrupt priority"
	default 1

config GPIO_LOWRISC_15_PRIORITY
	int "GPIO 15 interrupt priority"
	default 1

config GPIO_LOWRISC_16_PRIORITY
	int "GPIO 16 interrupt priority"
	default 1

config GPIO_LOWRISC_17_PRIORITY
	int "GPIO 17 interrupt priority"
	default 1

config GPIO_LOWRISC_18_PRIORITY
	int "GPIO 18 interrupt priority"
	default 1

config GPIO_LOWRISC_19_PRIORITY
	int "GPIO 19 interrupt priority"
	default 1

config GPIO_LOWRISC_20_PRIORITY
	int "GPIO 20 interrupt priority"
	default 1

config GPIO_LOWRISC_21_PRIORITY
	int "GPIO 21 interrupt priority"
	default 1

config GPIO_LOWRISC_22_PRIORITY
	int "GPIO 22 interrupt priority"
	default 1

config GPIO_LOWRISC_23_PRIORITY
	int "GPIO 23 interrupt priority"
	default 1

config GPIO_LOWRISC_24_PRIORITY
	int "GPIO 24 interrupt priority"
	default 1

config GPIO_LOWRISC_25_PRIORITY
	int "GPIO 25 interrupt priority"
	default 1

config GPIO_LOWRISC_26_PRIORITY
	int "GPIO 26 interrupt priority"
	default 1

config GPIO_LOWRISC_27_PRIORITY
	int "GPIO 27 interrupt priority"
	default 1

config GPIO_LOWRISC_28_PRIORITY
	int "GPIO 28 interrupt priority"
	default 1

config GPIO_LOWRISC_29_PRIORITY
	int "GPIO 29 interrupt priority"
	default 1

config GPIO_LOWRISC_30_PRIORITY
	int "GPIO 30 interrupt priority"
	default 1

config GPIO_LOWRISC_31_PRIORITY
	int "GPIO 31 interrupt priority"
	default 1

endif # GPIO_SIFIVE
```

## drivers/pinmux/Kconfig.lowrisc
```kconfig
# Kconfig.fe310 - PINMUX configuration options for SiFive Freedom SOC
#
# Copyright (c) 2017 Jean-Paul Etienne <fractalclone@gmail.com>
#
# SPDX-License-Identifier: Apache-2.0
#

menuconfig PINMUX_LOWRISC
	bool "lowRISC SOC pinmux driver"
	depends on SOC_SERIES_RISCV_LOWRISC
	help
	  Enable driver for the lowRISC SOC pinmux driver

if PINMUX_LOWRISC

config PINMUX_SIFIVE_0_NAME
	string "SIFIVE pinmux 0 driver name"
	default "pinmux0"

endif # PINMUX_LOWRISC
```

## drivers/serial/Kconfig.lowrisc
```kconfig
# Kconfig.fe310 - SiFive Freedom UART configuration option
#
# Copyright (c) 2017 Jean-Paul Etienne <fractalclone@gmail.com>
#
# SPDX-License-Identifier: Apache-2.0
#

menuconfig UART_LOWRISC
	bool "lowRISC serial driver"
	depends on SOC_RISCV_LOWRISC
	select SERIAL_HAS_DRIVER
	select SERIAL_SUPPORT_INTERRUPT
	help
	  This option enables the lowRISC serial driver.

# ---------- Port 0 ----------

menuconfig UART_LOWRISC_PORT_0
	bool "Enable LOWRISC Port 0"
	depends on UART_LOWRISC
	help
	  This tells the driver to configure the UART port at boot, depending on
	  the additional configure options below.

config UART_LOWRISC_PORT_0_IRQ_PRIORITY
	int "Port 0 Interrupt Priority"
	default 1
	depends on UART_LOWRISC_PORT_0
	help
	  Port 0 Interrupt Priority

config UART_LOWRISC_PORT_0_RXCNT_IRQ
	int "Port 0 RX Interrupt Threshold Count"
	default 0
	depends on UART_LOWRISC_PORT_0
	help
	  Port 0 RX Threshold at which the RX FIFO interrupt triggers.

config UART_LOWRISC_PORT_0_TXCNT_IRQ
	int "Port 0 TX Interrupt Threshold Count"
	default 0
	depends on UART_LOWRISC_PORT_0
	help
	  Port 0 TX Threshold at which the TX FIFO interrupt triggers.

# ---------- Port 1 ----------

menuconfig UART_LOWRISC_PORT_1
	bool "Enable LOWRISC Port 1"
	depends on UART_LOWRISC
	help
	  This tells the driver to configure the UART port at boot, depending on
	  the additional configure options below.

config UART_LOWRISC_PORT_1_IRQ_PRIORITY
	int "Port 1 Interrupt Priority"
	default 1
	depends on UART_LOWRISC_PORT_1
	help
	  Port 1 Interrupt Priority

config UART_LOWRISC_PORT_1_RXCNT_IRQ
	int "Port 0 RX Interrupt Threshold Count"
	default 0
	depends on UART_LOWRISC_PORT_1
	help
	  Port 1 RX Threshold at which the RX FIFO interrupt triggers.

config UART_LOWRISC_PORT_1_TXCNT_IRQ
	int "Port 1 TX Interrupt Threshold Count"
	default 0
	depends on UART_LOWRISC_PORT_1
	help
	  Port 1 TX Threshold at which the TX FIFO interrupt triggers.
```

## dts/bindings/gpio/lowrisc,gpio0.yaml
```yaml
#
# Copyright (c) 2018, SiFive Inc.
#
# SPDX-License-Identifier: Apache-2.0
#

title: lowRISC GPIO

description: >
    This is a representation of the lowRISCGPIO nodes

inherits:
    !include [gpio-controller.yaml, base.yaml]

properties:
    compatible:
      constraint: "lowrisc,gpio0"

    reg:
      category: required

    label:
      category: required

    interrupts:
      category: required

"#cells":
  - pin
  - flags
```

## dts/bindings/interrupt-controller/lowrisc,plic-1.0.0.yaml
```yaml
# Copyright (c) 2018, SiFive Inc.
#
# SPDX-License-Identifier: Apache-2.0

title: lowRISC PLIC
description: lowRISC RISCV-V platform-local interrupt controller

inherits:
    !include riscv,plic0.yaml

properties:
    compatible:
        constraint: "lowrisc,plic-1.0.0"

    riscv,ndev:
        type: int
        description: Number of external interrupts supported
        category: required
```

## dts/bindings/serial/lowrisc,uart0.yaml
```yaml
#
# Copyright (c) 2018, SiFive Inc.
#
# SPDX-License-Identifier: Apache-2.0
#

title: LOWRISC UART

description: >
    This binding gives a base representation of the LOWRISC UART

inherits:
    !include uart.yaml

properties:
    compatible:
      constraint: "lowrisc,uart0"

    reg:
      category: required

    interrupts:
      category: required
```

## dts/bindings/spi/lowrisc,spi0.yaml
```yaml
#
# Copyright (c) 2018, SiFive Inc.
#
# SPDX-License-Identifier: Apache-2.0
#

title: lowRISC SPI driver

description: >
    This binding gives a base representation of the lowRISC SPI controller

inherits:
    !include spi.yaml

properties:
    compatible:
      constraint: "lowrisc,spi0"

    reg:
      category: required
```

## dts/bindings/sram/lowrisc,dtim0.yaml
```yaml
#
# Copyright (c) 2019 Antmicro <www.antmicro.com>
#
# SPDX-License-Identifier: Apache-2.0
#

title: Data Tightly-Integrated Memory

description: >
    This bindings describes the SiFive Data Tightly-Integrated Memory

inherits:
    !include base.yaml

properties:
    compatible:
      constraint: "lowrisc,dtim0"

    reg:
      category: required
```

## soc/riscv/riscv-privilege/lowrisc/Kconfig.defconfig.series
```kconfig
# SPDX-License-Identifier: Apache-2.0

if SOC_SERIES_RISCV_LOWRISC

config SOC_SERIES
	string
	default "lowrisc"

config SYS_CLOCK_HW_CYCLES_PER_SEC
	int
	default 32768

config RISCV_SOC_INTERRUPT_INIT
	bool
	default y

config RISCV_HAS_CPU_IDLE
	bool
	default y

config RISCV_HAS_PLIC
	bool
	default y

config NUM_IRQS
	int
	default 64

config XIP
	bool
	default y

endif # SOC_SERIES_RISCV_LOWRISC
```

## soc/riscv/riscv-privilege/lowrisc/Kconfig.series
```kconfig
# Kconfig - RISCV_LOWRISC SOC implementation
#
# Copyright (c) 2017 Jean-Paul Etienne <fractalclone@gmail.com>
#
# SPDX-License-Identifier: Apache-2.0
#

config SOC_SERIES_RISCV_LOWRISC
	bool "lowRISC SOC implementation"
	depends on RISCV
	select SOC_FAMILY_RISCV_PRIVILEGE
	help
	  Enable support for lowRISC SoC series
```

## soc/riscv/riscv-privilege/lowrisc/Kconfig.soc
```kconfig
# Kconfig - RISCV_LOWRISC SOC configuration options
#
# Copyright (c) 2017 Jean-Paul Etienne <fractalclone@gmail.com>
#
# SPDX-License-Identifier: Apache-2.0
#

choice
prompt "lowRISC SOC implementation"
depends on SOC_SERIES_RISCV_LOWRISC

config SOC_RISCV_LOWRISC
	bool "lowRISC SOC implementation"
	select ATOMIC_OPERATIONS_C

endchoice
```
